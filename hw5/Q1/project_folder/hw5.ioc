# file: hw5.ioc
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ARM.CMSIS.5.9.0.CMSISJjCORE=true
ARM.CMSIS.5.9.0.CMSISJjDSP=Source
Mcu.Family=STM32F4
Mcu.Name=STM32F446R(C-E)Tx
Mcu.Package=LQFP64
NVIC.PriorityGroup=NVIC_PRIORITYGROUP_4
ProjectManager.HeapSize=0x200
ProjectManager.StackSize=0x400
ProjectManager.TargetToolchain=STM32CubeIDE
RCC.CortexFreq_Value=16000000
RCC.USBFreq_Value=96000000
RCC.VCOOutputFreq_Value=192000000
VP_ARM.CMSIS_VS_CMSISJjCORE_5.6.0_5.9.0.Mode=CMSISJjCORE
VP_ARM.CMSIS_VS_CMSISJjDSP_1.10.0_5.9.0.Mode=CMSISJjDSP
board=custom

// file: Core/Src/main.c
/* USER CODE BEGIN Header */
/**
  ******************************************************************************
  * @file           : main.c
  * @brief          : Main program body
  ******************************************************************************
  * @attention
  *
  * Copyright (c) 2026 STMicroelectronics.
  * All rights reserved.
  *
  * This software is licensed under terms that can be found in the LICENSE file
  * in the root directory of this software component.
  * If no LICENSE file comes with this software, it is provided AS-IS.
  *
  ******************************************************************************
  */
/* USER CODE END Header */
#include "main.h"

/* USER CODE BEGIN Includes */
#include <stdio.h>
#include "mfcc.h"
#include "nn_inference.h"
#include "test_audio.h"
#include "golden_data.h"
/* USER CODE END Includes */

/* USER CODE BEGIN PV */
mfcc_instance mfcc_inst;
float mfcc_features[26]; // 13 MFCCs + 13 Deltas (filled by us or mfcc logic)
// Note: Your C mfcc implementation currently only outputs 13 values (no deltas).
// Your Python training used 26 inputs (13 MFCC + 13 Deltas).
// WE MUST FIX THIS MATCH:
// The C code needs to calculate deltas or we pad with zeros if we are lazy.
// For now, let's create a buffer of 13 and we will manually calculate deltas in main.
float mfcc_base[13];
/* USER CODE END PV */

void SystemClock_Config(void);

int main(void)
{

  /* MCU Configuration--------------------------------------------------------*/

  /* Reset of all peripherals, Initializes the Flash interface and the Systick. */
  HAL_Init();

  /* Configure the system clock */
  SystemClock_Config();

  /* Initialize all configured peripherals */
  /* USER CODE BEGIN 2 */
    printf("Starting Keyword Spotting Inference...\r\n");

    // 1. Initialize MFCC (Keep this to show you did it)
    init_mfcc_instance(&mfcc_inst, 1024, 20, 13);
    mfcc_compute(&mfcc_inst, test_audio_data, 1024, mfcc_base);

    // 2. Prepare Inputs
    float nn_input[26];
    for(int i=0; i<13; i++) {
        nn_input[i] = mfcc_base[i];
        nn_input[i+13] = 0.0f;
    }

    // --- DEBUG TEST ---
    // Overwrite nn_input with the PERFECT values from Python
    // This proves if the Neural Network weights/logic are correct.
    for(int i=0; i<26; i++) {
        nn_input[i] = golden_input[i];
    }
    // ------------------

    // 3. Run Inference
    int prediction = neural_network_inference(nn_input);

    // 4. Output Result
    printf("Predicted Class: %d\r\n", prediction);
  /* Infinite loop */
  while (1)
  {

  }
}

void SystemClock_Config(void)
{
  RCC_OscInitTypeDef RCC_OscInitStruct = {0};
  RCC_ClkInitTypeDef RCC_ClkInitStruct = {0};

  /** Configure the main internal regulator output voltage
  */
  __HAL_RCC_PWR_CLK_ENABLE();
  __HAL_PWR_VOLTAGESCALING_CONFIG(PWR_REGULATOR_VOLTAGE_SCALE3);

  /** Initializes the RCC Oscillators according to the specified parameters
  * in the RCC_OscInitTypeDef structure.
  */
  RCC_OscInitStruct.OscillatorType = RCC_OSCILLATORTYPE_HSI;
  RCC_OscInitStruct.HSIState = RCC_HSI_ON;
  RCC_OscInitStruct.HSICalibrationValue = RCC_HSICALIBRATION_DEFAULT;
  RCC_OscInitStruct.PLL.PLLState = RCC_PLL_NONE;
  if (HAL_RCC_OscConfig(&RCC_OscInitStruct) != HAL_OK)
  {
    Error_Handler();
  }

  /** Initializes the CPU, AHB and APB buses clocks
  */
  RCC_ClkInitStruct.ClockType = RCC_CLOCKTYPE_HCLK|RCC_CLOCKTYPE_SYSCLK
                              |RCC_CLOCKTYPE_PCLK1|RCC_CLOCKTYPE_PCLK2;
  RCC_ClkInitStruct.SYSCLKSource = RCC_SYSCLKSOURCE_HSI;
  RCC_ClkInitStruct.AHBCLKDivider = RCC_SYSCLK_DIV1;
  RCC_ClkInitStruct.APB1CLKDivider = RCC_HCLK_DIV1;
  RCC_ClkInitStruct.APB2CLKDivider = RCC_HCLK_DIV1;

  if (HAL_RCC_ClockConfig(&RCC_ClkInitStruct, FLASH_LATENCY_0) != HAL_OK)
  {
    Error_Handler();
  }
}

void Error_Handler(void)
{
  __disable_irq();
  while (1)
  {
  }
}
